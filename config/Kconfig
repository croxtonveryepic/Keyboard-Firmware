## config/Kconfig
```kconfig
DT_COMPAT_ZMK_BEHAVIOR_CAPS_SNAKE := zmk,behavior-caps-snake

config ZMK_BEHAVIOR_CAPS_SNAKE
    bool
    default $(dt_compat_enabled,$(DT_COMPAT_ZMK_BEHAVIOR_CAPS_SNAKE))
```

## config/dts/bindings/behaviors/zmk,behavior-caps-snake.yaml
```yaml
# Copyright (c) 2026 Jonathan Croxton
# SPDX-License-Identifier: MIT

description: Unified automatic and locked CapsSnake behavior

compatible: "zmk,behavior-caps-snake"

include: one_param.yaml

properties:
  layer:
    type: int
    required: true
    description: Layer used for shifted letters and underscore.
  continue-list:
    type: array
    required: true
    description: Key codes which keep automatic mode active.
  ignore-alphas:
    type: boolean
    description: Keep automatic mode active for alphabetic keys.
  ignore-numbers:
    type: boolean
    description: Keep automatic mode active for numeric keys.
  ignore-modifiers:
    type: boolean
    description: Keep automatic mode active for modifier keys.
```
